## config/west.yml
```yaml
manifest:
  remotes:
    - name: zmkfirmware
      url-base: https://github.com/zmkfirmware
    - name: mctechnology17 #new entry
      url-base: https://github.com/mctechnology17 #new entry
  projects:
    - name: zmk
      remote: zmkfirmware
      revision: main
      import: app/west.yml
    - name: zmk-nice-oled #new entry
      remote: mctechnology17 #new entry
      revision: main #new entry
  self:
    path: config
```
